## app/west.yml
```yaml
manifest:
  remotes:
    - name: zephyrproject-rtos
      url-base: https://github.com/zephyrproject-rtos
    - name: zmkfirmware
      url-base: https://github.com/zmkfirmware
    - name: tompi
      url-base: https://github.com/tompi
  projects:
    - name: zephyr
      remote: zmkfirmware
      revision: v4.1.0+zmk-fixes
      clone-depth: 1
      import:
        name-blocklist:
          - ci-tools
          - hal_altera
          - hal_cypress
          - hal_infineon
          - hal_microchip
          - hal_nxp
          - hal_openisa
          - hal_xtensa
          - hal_st
          - hal_ti
          - loramac-node
          - mcuboot
          - mcumgr
          - net-tools
          - openthread
          - edtt
          - trusted-firmware-m
    - name: hal_stm32
      revision: 4fcc3a3f32abe1c4cb76d9d1cef967728dd03908
      path: modules/hal/stm32
      remote: zmkfirmware
      groups:
        - hal
    - name: lvgl
      revision: f1db87ee98f1810328a8419572fa42a3b5f352ae
      path: modules/lib/gui/lvgl
      remote: zmkfirmware
    - name: zmk-studio-messages
      revision: 9a47c7e11be82038ea100f28e78e7617ab0e81a4
      path: modules/msgs/zmk-studio-messages
      remote: tompi
  group-filter: [+optional]
  self:
    west-commands: scripts/west-commands.yml
```
